## buildroot_external/Config.in
```kconfig
source "$BR2_EXTERNAL_project_customization_PATH/packages/rpi_sensors/Config.in"
source "$BR2_EXTERNAL_project_customization_PATH/packages/rpi_web_app/Config.in"
```

## buildroot_external/packages/rpi_sensors/Config.in
```kconfig
config BR2_PACKAGE_RPI_SENSORS
    bool "rpi_sensors"
    select BR2_PACKAGE_SQLITE
    help
      A simple sensor application that uses SQLite to store sensors data.
```

## buildroot_external/packages/rpi_web_app/Config.in
```kconfig
config BR2_PACKAGE_RPI_WEB_APP
    bool "Raspberry Pi Flask Web App"
    depends on BR2_PACKAGE_PYTHON_FLASK
    help
      Installs the Flask-based Python web application.
```
